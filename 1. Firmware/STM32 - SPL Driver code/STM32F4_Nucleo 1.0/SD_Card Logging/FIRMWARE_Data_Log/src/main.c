/*
******************************************************************************
File:     SD LOG BUOY
Info:     Generated by Atollic TrueSTUDIO(R) 7.1.1   2019-07-07

The MIT License (MIT)
Copyright (c) 2009-2017 Atollic AB

THIS FILE CONTAINS THE FIRMWARE FOR THE SHARCBUOY DEPLOYED WITH AN SD CARD

This device will log ALL data to the SD Card and will not transmit any data
Permission is hereby granted, free of charge, to any person obtaining a copy
of this software and associated documentation files (the "Software"), to deal
in the Software without restriction, including without limitation the rights
to use, copy, modify, merge, publish, distribute, sublicense, and/or sell
copies of the Software, and to permit persons to whom the Software is
furnished to do so, subject to the following conditions:

The above copyright notice and this permission notice shall be included in all
copies or substantial portions of the Software.

THE SOFTWARE IS PROVIDED "AS IS", WITHOUT WARRANTY OF ANY KIND, EXPRESS OR
IMPLIED, INCLUDING BUT NOT LIMITED TO THE WARRANTIES OF MERCHANTABILITY,
FITNESS FOR A PARTICULAR PURPOSE AND NONINFRINGEMENT. IN NO EVENT SHALL THE
AUTHORS OR COPYRIGHT HOLDERS BE LIABLE FOR ANY CLAIM, DAMAGES OR OTHER
LIABILITY, WHETHER IN AN ACTION OF CONTRACT, TORT OR OTHERWISE, ARISING FROM,
OUT OF OR IN CONNECTION WITH THE SOFTWARE OR THE USE OR OTHER DEALINGS IN THE
SOFTWARE.

******************************************************************************
*/

/* Includes */
#include "stm32f4xx.h"
#include "stdlib.h"
#include "../My_Libs/RTC.h"
#include "../My_Libs/eeprom.h"
#include "../My_Libs/Delay.h"
#include "../My_Libs/GPS.h"
#include "../My_Libs/Iridium.h"
#include "../IMU_SRC/IMU.h"
#include "../env_src/BMP280.h"
#include "../env_src/Wind.h"
#include "../SD_CARD/tm_stm32f4_fatfs.h"
#include "tm_stm32f4_delay.h"
//for debugging purposes
#include "tm_stm32f4_usart.h"
/* Private Structs*/
typedef struct
{
	uint8_t ID;
	Coord_t coord;
	uint32_t Etime;
	Diagnostic_t diag;
	BMP280_data_t bmp;
	uint16_t wind_dir;
	uint16_t wind_speed;
	float temp;
	float Pressure;
	uint16_t battery_voltage;
	uint16_t battery_current;

} Packet;

/* Private macro */
#define length(x) sizeof(x)/sizeof(*x)
#define IRIDIUM_TIMEOUT_ATTEMPTS 5
/*
 * Program has option of either straight to Iridium Data transmission or Mass Storage option
 * To enable Mass storage uncomment the line #define USE_MASS_STORAGE
 * options:	 0 - Flash Chip
 * 			 1 - SD CARD
 */
#define USE_MASS_STORAGE 1
#define USART_DEBUG USART2
/* Private Typedefs */
RTC_TimeTypeDef rtc_time;
RTC_AlarmTypeDef RTC_alarma;
Packet packet;
BMP280_data_t BMPData;
/*
 * variable for time stamping
 */
time_t systime;

/* private Variables*/
float temp;
FATFS fatfs;
FIL file;
const char* GPS_FILE ="gps.txt";
const char* IMU_FILE ="IMU.txt";
/* private Data Buffers*/
char fbuff[60];
uint8_t packet_buff[37];

/*
 * private virtual address variables for storage in emulated eeprom
 */
uint16_t VirtAddVarTab[4] = {0x0B,0x31,0x57,0x7D}; //base addresses for GPS data packets
uint16_t VarDataTab[4] = {0, 0, 0};
uint16_t nextPacketID = 0;
uint16_t routineCountNo = 0;
uint32_t sysTime;
uint16_t VirtPacketAdd = 0x0001;
uint16_t VirtCounterAdd	= 0x0002;
uint16_t timeVirtAdd1 = 0x0003;
uint16_t timeVirtAdd2 = 0x0004;
uint8_t device[8];

RTC_TimeTypeDef rtc_time;
RTC_DateTypeDef rtc_date;
/* private state flags */
uint8_t init_State, log_State, Transmit_State, IMU_State,Deployment_State;

/* private peripheral flags */
uint8_t temp_On,VBat_On,GPS_On,Iridium_On,IMU_On,WeatherVane_On,SD_On;


/* Private function prototypes */

/* RCC and System Functions */
void init_RCC_Clock(void);
void init_All_Pins(void);
/* Data Processing functions*/
void ftoa(float f);
int32_t float_to_int(float f);
void clear_packet(void);
void to_binary_format(Packet packet, uint8_t ID);
void save_Data(uint8_t* data, int length, uint16_t virtualAddressBase);
void init_LED(void);
void init_Reed_Switch(void);


/**
**===========================================================================
**
**  Abstract: main program
**
**===========================================================================
*/
int main(void)
{
	/******************** DEBUGGING INITS **********************************/
	/*
	 * NOTE: DELETE BEFORE Deployment
	 */
	init_LED();



  /********************** Base Initializations *****************************/
  init_RCC_Clock();
  init_RTC();
  init_Delay();
  init_Reed_Switch();
  init_State = 0;
  log_State = 0;
  Transmit_State = 0;
  IMU_State = 0;
  Deployment_State = 0;
  /*********************** System State Check ******************************/


  /* Check if wake up came from power or external*/
  if(PWR_GetFlagStatus(PWR_FLAG_WU) == SET)
  {
	  /* Disable Power*/
	  RCC_APB1PeriphResetCmd(RCC_APB1Periph_PWR,DISABLE);
	  /* Enable access to back up registers*/
	  PWR_BackupAccessCmd(ENABLE);

	  /* Check if packet was saved successfully*/
	  uint8_t address_empty = EE_ReadVariable(VirtPacketAdd,&nextPacketID);
	  /* If empty, first data needs to be read*/
	  if(address_empty)
	  {
		  nextPacketID = 1;
		  log_State = 1;
	  }else
	  {
		  //read the last ID
		  if(nextPacketID == 4)
		  {
			  /* signal for transmission after last packet*/
			  //Transmit_State = 1;
			  log_State = 1;
			  IMU_State = 1;
		  }

		  else if( nextPacketID > 4)
		  {
			  nextPacketID = 0;
		  }
		  else
		  {
			  IMU_State = 1;
			  log_State = 1;
		  }
	  }
	  /*	Read Number of routines	   */
	  uint8_t routine_empty = EE_ReadVariable(VirtCounterAdd,&routineCountNo);
	  if(!routine_empty)
	  {
		  //perform IMU function every 6 hours or every
		 routineCountNo++;
	  }
	  /* update next packet ID*/
	  packet.ID = nextPacketID++;
	  FLASH_Unlock();
	  EE_Init();
	  EE_WriteVariable(VirtPacketAdd,nextPacketID);
	  EE_WriteVariable(VirtCounterAdd,routineCountNo);
	  //Update Status LED to indicate stage in cycle
	  /* Clear Warm up flag*/
	  PWR_ClearFlag(PWR_FLAG_WU);

  }else
  {
	  /* Power on */
	  init_State = 1;
	  /* Init ID*/
	  FLASH_Unlock();
	  EE_Init();
	  nextPacketID = 2;
	  log_State = 1;
	  IMU_State = 1;
	  EE_WriteVariable(VirtPacketAdd,nextPacketID);
	  EE_WriteVariable(VirtCounterAdd,0);
	  //UPDATE LED STATUS TO INIT ROUTINE
	  for (int var = 0; var < 3; ++var)
	{
		GPIO_WriteBit(GPIOA,GPIO_Pin_5,SET);
		Delay_begin_Timeout(500);
		while(!timeout);
		GPIO_WriteBit(GPIOA,GPIO_Pin_5,RESET);
		Delay_begin_Timeout(500);
		while(!timeout);
	}
  }
  /*
   * Check to See if system is in deployment mode
   */
 // Deployment_State = GPIO_ReadInputDataBit(GPIOC,GPIO_Pin_5);
  /********************* Peripheral initializations ***********************/
if(log_State)
{
  /*
   * 1. GPS
   */
  	  init_USART_GPS();
  /*
   * 2. Temp Sensor
   */
//  	  if(BMP280_Begin() == BMP_OK)
//  	  {
//  		  //load trimming parameters for temp and pressure compensation
//  		  BMP280_GetCoeff(&bmp);
//  		  //configure ctrl measurement register
//  		  BMP280_Configure_CTRLMEAS(BMP280_CTRLMEAS_OSRST_OS_1,BMP280_CTRLMEAS_OSRSP_OS_1,BMP280_CTRLMEAS_MODE_SLEEP);
//  		  //configure filter, i2c mode, odr
//  		  BMP280_Configure_Config(BMP280_CONFIG_tsb_1000,BMP280_CONFIG_FILTER_COEFF_OFF,BMP280_CONFIG_SPI3_DIS);
//  		  temp_On = 1;
//  	  }

  /*
   * 3. Battery Monitor
   */
  	  //VBat_On = init_Battery_ADC()&0b1;

  /*
   * 4. Weather Vane
   */
  	  init_ADC(ADC_AN,Weather_Vane_Pin);
  	  init_InputCapture(Wind_Speed_Pin);
  	  WeatherVane_On = 1;

  /*
   * 5. Mass Storage
   */

#ifdef USE_MASS_STORAGE
  	  switch(USE_MASS_STORAGE)
  	  {
  	  case 0:
  		  __NOP();
  		  break;
  	  case 1:
  		 TM_DELAY_Init();
  		 if(f_mount(&fatfs,"",1) == FR_OK)
  		  {
  			  //try to open file
  			  SD_On = 1;
  			  f_open(&file,"diag.txt",FA_OPEN_APPEND | FA_WRITE);
  			  f_puts("Successfully Opened \r\n",&file);
  			  f_close(&file);
  		  }


  	  }
#endif
  /*************** Routine 1: Collect GPS and store in a packet ***********/

if(log_State)
{
	/* Acquire GPS signal*/
	Delay_begin_Timeout(300000);
	GPS_On = 0;
	while(!timeout)
	{
		if(packet_full == 7)
		{
			/* Disable delay and end comms*/
			Delay_Disable();
			deinit_USART_GPS();
			GPS_On = 1;
			break;
		}
	}

	/* Temp and Pressure Algorithm */
	if(temp_On)
	{
		//force a measurement
		BMP280_Force_Measure(&BMPData.temp,&BMPData.press);
		packet.bmp.temp = BMPData.temp;
		packet.bmp.press = BMPData.press;

	}
	/* If Weather Vane Connected, sample Direction and Speed*/
	if(WeatherVane_On)
	{
		packet.wind_dir = get_Wind_Direction();
		packet.wind_speed = get_Wind_Speed();
	}
	/* If Battery Monitor Available Get Battery Voltage*/
	if(VBat_On)
	{
		/* Convert divided voltage to nominal voltage value*/

	}

	/* If GPS is available, acquire signal and store data*/
	if(GPS_On)
	{
		/* Transfer Data to packet*/
		packet.Etime = eTime;
		packet.coord = GPS_coord;
		packet.diag = diag;
	}
	/* TIME STAMP*/
	if(eTime == 0)
	{
		// load time variable from
		uint16_t t1,t2;
		EE_ReadVariable(timeVirtAdd1,&t1);
		EE_ReadVariable(timeVirtAdd2,&t2);

		RTC_GetTime(RTC_Format_BIN,&rtc_time);
		sysTime= (t1 | (t2 << 16)) + RTC_To_Unix_Time(&rtc_time,&rtc_date);

	}else
	{
		sysTime = eTime;
	}
	/* Storage */

/*
 *  LOG TO SD CARD NO COMPRESSION OR STORAGE
 */
	if(SD_On)
	{

		//end
		f_open(&file,GPS_FILE,FA_OPEN_APPEND | FA_WRITE);
		if(f_size(&file) > 0)
		{
			f_lseek(&file,f_size(&file));
		}

		char time_buff[100];
		get_Time(sysTime,time_buff);
		f_puts((char*)time_buff,&file);
		char log_buff[70];
		int lat[3],longi[3];
		lat[0] = packet.coord.lat/100;
		lat[1] = abs(packet.coord.lat - lat[0]*100);
		lat[2] = abs((packet.coord.lat- (int)(packet.coord.lat))*10000);
		longi[0] = packet.coord.longi/100;
		longi[1] = abs((packet.coord.longi - longi[0]*100));
		longi[2] = abs((packet.coord.longi- (int)(packet.coord.longi))*10000);
		sprintf(log_buff,"Nav info:Time = %d, lat = %d°%d.%d', long = %d°%d.%d' \r\n",sysTime,lat[0],lat[1],lat[2],longi[0],longi[1],longi[2]);
		f_puts((char*)log_buff,&file);
		char diag_buff[100];
		sprintf(diag_buff,"Diag info: Number of satellites = %d, PDOP = %d.%d, HDOP = %d.%d, VDOP = %d.%d, Signal type: %d\r\n",packet.diag.num_sats,packet.diag.PDOP.digit,packet.diag.PDOP.precision,packet.diag.HDOP.digit,packet.diag.HDOP.precision,packet.diag.VDOP.digit,packet.diag.VDOP.precision,packet.diag.fix_type);
		f_puts((char*)diag_buff,&file);
		f_close(&file);
	}
	else
	{
		to_binary_format(packet, packet.ID);
		FLASH_Unlock();
		EE_Init();
		save_Data(packet_buff,length(packet_buff), VirtAddVarTab[packet.ID - 1]);
	}
}



}

/********************** Routine 2:IMU Sample ************************************/
/*
 * Debug version:
 * Sample IMU at a known rate. Store data in EEPROM memory at known virtual address
 * When finished, read all data and transmit via UASART 2  PA2, PA3
 */
if(IMU_State)
{
	/*
	 * Initialise I2C command and
	 */
	IMU_On = init_IMU();
	//Communication link to check data
	TM_USART_Init(USART2,TM_USART_PinsPack_1,115200);
	//Communication link to check data
	if(IMU_On)
	{
		uint8_t string[] = "IMU FOUND!..Sampling\n\r";
		TM_USART_Send(USART2,string,length(string));
		init_Timer();
		while(!sample_finished);
		//read off data
		uint16_t VirtIMUAdd[6] = {0xD0,0x1391,0x2652,0x3913,0x4BD4,0x5E95};
		/*
		 * After sampling, data will be sent either to storage or iridium based on
		 * User Decision
		 */
		if(log_State)
		{
			//check for SD card
			if(SD_On)
			{
				//get RTC info

				f_open(&file,IMU_FILE,FA_OPEN_APPEND | FA_WRITE);
				if(f_size(&file) > 0)
				{
					f_lseek(&file,f_size(&file));
				}

				 char buff[60];
				 get_Time(sysTime,buff);
				 f_puts((char *)buff,&file);
				 sprintf(buff,"Sampled at %d Hz for %d minutes\r\n", SAMPLE_RATE,SAMPLE_TIME_MIN);
				 f_puts((char *)buff,&file);
				 for (int i = 0; i < __numSamples(); ++i)
				 {
					//load data set from EEPROM
					uint16_t temp_axes[6] = {0};
					EE_ReadVariable(VirtIMUAdd[0]++,temp_axes);
					EE_ReadVariable(VirtIMUAdd[1]++,&temp_axes[1]);
					EE_ReadVariable(VirtIMUAdd[2]++,&temp_axes[2]);
					EE_ReadVariable(VirtIMUAdd[3]++,&temp_axes[3]);
					EE_ReadVariable(VirtIMUAdd[4]++,&temp_axes[4]);
					EE_ReadVariable(VirtIMUAdd[5]++,&temp_axes[5]);
					//write line to SD Card
					sprintf(buff,"Ax = %d,\tAy = %d,\tAz = %d,\tGx = %d,\tGy = %d,\tGz = %d\r\n",(int16_t)temp_axes[0],(int16_t)temp_axes[1],(int16_t)temp_axes[2],(int16_t)temp_axes[3],(int16_t)temp_axes[4],(int16_t)temp_axes[5]);
					f_puts((char *)buff,&file);
				 }
				 //close
				 f_close(&file);
				 f_mount(0,"",1);
				 //increment file number
			}
		}
	}else
	{
		uint8_t string[] = "NO IMU FOUND\n\r";
		TM_USART_Send(USART2,string,length(string));
	}



}

/********************** Routine 3: Iridium Transmit *****************************/

  if(Transmit_State)
  {

	 /* Initialise Iridium Module */
	  Iridium_On = 0;
	  for (int i = 0; i < IRIDIUM_TIMEOUT_ATTEMPTS; ++i)
	  {

		  uint8_t ir_flag = init_Iridium_Module();
		 if (ir_flag ==0 )
		 {

		 	Iridium_On = 1;
		 	break;
		 }else
		 {
		 	deinit_Iridium_Module();
		 }
		 /* Delay for 3 seconds*/
		 Delay_begin_Timeout(3000);
		 while(!timeout);

	  }
	  /* If Communications was successful*/
	  if(Iridium_On)
	  {

		  /* Create a message buffer for all packets*/
		  clear_packet();
		  uint32_t size = length(packet_buff);
		  uint32_t numpackets = length(VirtAddVarTab);
		  uint8_t temp_log[size*numpackets];
		 for (int i = 0; i < length(VirtAddVarTab); ++i)
		 {
			 /* load Data from FLASH into data buffer*/
			load_Data(&temp_log[i*size],VirtAddVarTab[i],size);

		 }
		 /* Upload data to modem*/
		 send_Binary_Message(temp_log,length(temp_log));
		 /* Wait for network availability*/
		 uint8_t retry = 0;
		 Delay_Disable();
		 Delay_begin_Timeout(100000);
		 timeout = 0;
		 while(!timeout)
		 {

				 /* Create SBD Session*/

				 Delay_Disable();
				 int flag = create_SBD_Session();
				 if(flag == 0)
				 {
					 /* Flush the Iridium message queue*/

					 send_ATcmd("AT+SBDD0\r",1000);
					 break;
				 }
				 /* If not successful, set delay for another 3 seconds*/
				 if(flag == -2)
				 {

					 if (retry < 8)
					 {
						 retry++;
					 }else
					 {
						 break;
					 }
				 }
		 }
		 /* Turn Off Module when done */
		 deinit_Iridium_Module();
		 nextPacketID = 0;
	  }

  	}
	// write time
	uint16_t t1,t2;

	t1 = sysTime & 0xFFFF;
	t2 = (sysTime&0xFFFF0000)>>16;
	EE_WriteVariable(timeVirtAdd1,t1);
	EE_WriteVariable(timeVirtAdd2,t2);
	/* SHUT DOWN ROUTINE */
	RTC_alarma.RTC_AlarmMask = RTC_AlarmMask_All;//&(~RTC_AlarmMask_Minutes);
	RTC_GetTime(RTC_Format_BIN,&rtc_time);
	rtc_time.RTC_Minutes += 30;
	set_RTCAlarm_A(&rtc_time,&RTC_alarma);

	/* Main Function, enter standby mode untill wake up*/
	while (1)
	{
		set_StdBy_Mode();
	}
}

void init_RCC_Clock(void)
{
	/* Set RCC value to default state*/
	RCC_DeInit();
	/* Enable external Crystal Oscilator*/
	RCC_HSEConfig(RCC_HSE_ON);
	ErrorStatus errorstatus = RCC_WaitForHSEStartUp();
	if(errorstatus == SUCCESS)
	{
		/* Configure PLL clock for 48 MHz*/
		RCC_PLLConfig(RCC_PLLSource_HSE,4,192,8,8);
		/* enable pll and wait until ready*/
		RCC_PLLCmd(ENABLE);
		while(RCC_GetFlagStatus(RCC_FLAG_PLLRDY) == RESET);

		/* Set Flash Latency*/
		FLASH_SetLatency(FLASH_Latency_1);
		/* Set AHB prescaler*/
		RCC_HCLKConfig(RCC_SYSCLK_Div1);
		/* Set APB1 Scaler */
		RCC_PCLK1Config(RCC_HCLK_Div2);
		/* Set APB2 Scaler*/
		RCC_PCLK2Config(RCC_HCLK_Div1);
		 /* Set Clock source to PLL*/
		 RCC_SYSCLKConfig(RCC_SYSCLKSource_PLLCLK);

	}else
	{
			//Set clock source to default config
			RCC_DeInit();
	}
	SystemCoreClockUpdate();
}
/*
 * @brief: Takes a float value and converts to a char array by storing
 * 		   Data in a global Buffer. The char array is uint8_t
 */


void to_binary_format(Packet packet,uint8_t ID)
{
	packet_buff[0] = ID; // ID
	packet_buff[1] = (packet.Etime&0xFF000000)>>24;
	packet_buff[2] = (packet.Etime&0x00FF0000)>>16;
	packet_buff[3] = (packet.Etime&0x0000FF00)>>8;
	packet_buff[4] = (packet.Etime&0x000000FF);
	/* Add coordinates bytes 1 - 5 = lat, bytes 6 - 10 = long*/
	union
	{
		float a;
		unsigned char bytes[4];
	} coord_int;
	coord_int.a = packet.coord.lat;
	for (int i = 5; i < 9; ++i)
	{
		packet_buff[i] = coord_int.bytes[i-5];
	}
	coord_int.a = packet.coord.longi;

	for (int i = 9; i < 13; ++i)
	{
			packet_buff[i] =  coord_int.bytes[i-9];
	}
	/* break time down into MSB and LSB and store as as 2 unsigned bytes in big endian */

	//convert HDOP,VDOP, PDOP to 2 bytes big endian
	packet_buff[13] = packet.diag.HDOP.digit;
	packet_buff[14] = packet.diag.HDOP.precision;
	packet_buff[15] = packet.diag.VDOP.digit;
	packet_buff[16] = packet.diag.VDOP.precision;
	packet_buff[17] = packet.diag.PDOP.digit;
	packet_buff[18] = packet.diag.PDOP.precision;
	packet_buff[19] = (packet.diag.num_sats);
	packet_buff[19] = packet_buff[19]<<2;
	packet_buff[19] |= packet.diag.fix_type;

	/*Temperature - 2 bytes (dec), (precision ) - 2 decimal places */
	if(temp_On)
	{
		//temp packets
		coord_int.a = packet.bmp.temp;
		packet_buff[20] = coord_int.bytes[3];
		packet_buff[21] = coord_int.bytes[2];
		packet_buff[22] = coord_int.bytes[1];
		packet_buff[23] = coord_int.bytes[0];
		//press
		coord_int.a = packet.bmp.press;
		packet_buff[24] = coord_int.bytes[3];
		packet_buff[25] = coord_int.bytes[2];
		packet_buff[26] = coord_int.bytes[1];
		packet_buff[27] = coord_int.bytes[0];

	}
	/* Battery Conversion: 2 bytes */
	if(WeatherVane_On)
	{
		packet_buff[28] = packet.wind_dir>>8;
		packet_buff[29] = packet.wind_dir&0xFF;
		packet_buff[30] = packet.wind_speed >>8;
		packet_buff[31] = packet.wind_speed&0xFF;
	}
	if(VBat_On)
	{
		packet_buff[32] = (packet.battery_voltage &0xFF00)>>8;
		packet_buff[33] = packet.battery_voltage &0xFF;
		packet_buff[34] = packet.battery_current >>8;
		packet_buff[35] = packet.battery_current&0xFF;
	}
	packet_buff[36] = 0xd; //end of packet character

}

void clear_packet(void)
{
	for (int i = 0; i < length(packet_buff); ++i)
	{
		 packet_buff[i]=0;
	}
}

void save_Data(uint8_t* data, int length, uint16_t virtualAddressBase)
{
	FLASH_Unlock();
	for (uint16_t var = 0; var < length; ++var)
	{
		EE_WriteVariable(virtualAddressBase+var, (uint16_t)data[var]);
	}
	FLASH_Lock();
}
/*
 * Note: This function detects the presence of a reed switch
 * if a magnet is connected the system will not transmit data
 * to iridium
 */
void init_Reed_Switch(void)
{
	RCC_AHB1PeriphClockCmd(RCC_AHB1Periph_GPIOC,ENABLE);
	GPIO_InitTypeDef GPIO_InitStruct;
	GPIO_InitStruct.GPIO_Mode = GPIO_Mode_IN;
	GPIO_InitStruct.GPIO_PuPd = GPIO_PuPd_NOPULL;
	GPIO_InitStruct.GPIO_Speed = GPIO_Speed_50MHz;
	GPIO_InitStruct.GPIO_Pin = GPIO_PIN_5;
	GPIO_Init(GPIOH,&GPIO_InitStruct);
}

void init_LED(void)
{
	RCC_AHB1PeriphClockCmd(RCC_AHB1Periph_GPIOA,ENABLE);
		GPIO_InitTypeDef GPIO_InitStruct;
		GPIO_InitStruct.GPIO_Mode = GPIO_Mode_OUT;
		GPIO_InitStruct.GPIO_Speed = GPIO_Speed_50MHz;
		GPIO_InitStruct.GPIO_Pin = GPIO_PIN_5;
		GPIO_Init(GPIOA,&GPIO_InitStruct);

}



/*
 * Function to set all pins to analog out
 */

